/* Net WAIS_v_7 - IOPT */
/* Automatic code generated by IOPT2C XSLT transformation. */
/* Please fill the necessary code to perform hardware IO. */


#include <stdlib.h>
#include "net_types.h"


#ifdef ARDUINO
#include <Arduino.h>
#define ANALOG_IN_MAX  1023
#define ANALOG_OUT_MAX 255
#else
#define INPUT    0
#define OUTPUT   1
#define ANALOG_IN_MAX  1023
#define ANALOG_OUT_MAX 1023
extern void pinMode( int, int );
extern int  digitalRead( int );
extern void digitalWrite( int, int );
extern int  analogRead( int );
extern void analogWrite( int, int );
#endif


// Remote IcE/Debug forced values:
#ifdef HTTP_SERVER
iopt_param_info *input_fv = NULL, *output_fv = NULL;
#endif


/* Executed just once, before net execution starts: */
void WAIS_v_7_InitializeIO()
{
}



/* Read all hardware input signals and fill data-structure */
void WAIS_v_7_GetInputSignals(
            WAIS_v_7_InputSignals* inputs,
            WAIS_v_7_InputSignalEvents* events )
{
    inputs->InS_Rain_Sensor = inputIOPTrainSensorValue;
    inputs->InS_Soil_Humidity_Sensor = 20;
#ifdef HTTP_SERVER
    if( input_fv != NULL ) force_WAIS_v_7_Inputs( input_fv, inputs );
#endif
}


/* Write all output values to physical hardware outputs */
void WAIS_v_7_PutOutputSignals(
            WAIS_v_7_PlaceOutputSignals* place_out,
            WAIS_v_7_EventOutputSignals* event_out,
            WAIS_v_7_OutputSignalEvents* events )
{
#ifdef HTTP_SERVER
    if( output_fv != NULL )
        force_WAIS_v_7_Outputs( output_fv, place_out, event_out );
#endif
    if (event_out->OuS_Valve == 1){
        digitalWrite(10, HIGH);
    }else{
        digitalWrite(10, LOW);
    }

}


/* Delay between loop iterations to save CPU and power consumption */
void WAIS_v_7_LoopDelay()
{
}

/* Must return 1 to finish net execution */
int WAIS_v_7_FinishExecution( WAIS_v_7_NetMarking* marking )
{
    return 0;
}



